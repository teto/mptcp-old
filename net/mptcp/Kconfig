## net/mptcp/Kconfig
```kconfig
#
# MPTCP configuration
#
config MPTCP
        bool "MPTCP protocol"
        depends on !SYN_COOKIES && !TCP_MD5SIG && (IPV6=y || IPV6=n)
        ---help---
          This replaces the normal TCP stack with a Multipath TCP stack,
          able to use several paths at once.

if MPTCP
	config MPTCP_DEBUG
		bool "Enable MPTCP extra debug messages"
		depends on MPTCP
		---help---
		Adds extra checks on MPTCP side, printing them when needed


endif #MPTCP
```
